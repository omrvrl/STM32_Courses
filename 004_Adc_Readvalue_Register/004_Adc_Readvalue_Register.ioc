# file: 004_Adc_Readvalue_Register.ioc
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Mcu.Family=STM32F1
Mcu.Name=STM32F103C(8-B)Tx
Mcu.Package=LQFP48
NVIC.PriorityGroup=NVIC_PRIORITYGROUP_4
PA13.Mode=Serial_Wire
PA13.Signal=SYS_JTMS-SWDIO
PA14.Mode=Serial_Wire
PA14.Signal=SYS_JTCK-SWCLK
ProjectManager.HeapSize=0x200
ProjectManager.StackSize=0x400
ProjectManager.TargetToolchain=STM32CubeIDE
RCC.APB1Freq_Value=8000000
RCC.APB2Freq_Value=8000000
board=custom

// file: Core/Src/main.c
/* USER CODE BEGIN Header */
/**
  ******************************************************************************
  * @file           : main.c
  * @brief          : Main program body
  ******************************************************************************
  * @attention
  *
  * Copyright (c) 2024 STMicroelectronics.
  * All rights reserved.
  *
  * This software is licensed under terms that can be found in the LICENSE file
  * in the root directory of this software component.
  * If no LICENSE file comes with this software, it is provided AS-IS.
  *
  ******************************************************************************
  */
/* USER CODE END Header */
#include "main.h"

/* USER CODE BEGIN PV */
uint16_t adc_value;
float Vadc;

/* USER CODE END PV */

void SystemClock_Config(void);
void Gpio_Config(void);
void Adc_Config(void);
void Read_Adc(void);

int main(void)
{

  /* MCU Configuration--------------------------------------------------------*/

  /* Reset of all peripherals, Initializes the Flash interface and the Systick. */
  HAL_Init();
  Gpio_Config();

  /* USER CODE BEGIN Init */
  Adc_Config();

  /* USER CODE END Init */

  /* Configure the system clock */
  SystemClock_Config();

  /* Initialize all configured peripherals */

  /* Infinite loop */
  while (1)
  {

    /* USER CODE BEGIN 3 */
	  Read_Adc();
  }
  /* USER CODE END 3 */
}

void SystemClock_Config(void)
{
	RCC->CR |= 0x03;                                     // hsi and hsiready on
	while(!(RCC->CR & (1<<1)));                         //wait hsi ready
	RCC->CR |= (1 << 19);								 // CSS ON
	RCC->CFGR &= ~(1 << 16);                             // HSI SOURCE HSI
	RCC->CFGR |= 0x0140000;								// pll x7
	RCC->CFGR |= (1<<1);								//PLL AS SYSTEM CLOCK
	RCC->CFGR |= (1 << 14);                             // ADC PRESCALER /4
	RCC->CIR  &= 0x0840000;								//flag reset(css and hsi)

}

/* USER CODE BEGIN 4 */
void Gpio_Config(){
	RCC->APB2ENR |= (1 << 2);                            //GPIOA CLOCK ENABLE
	GPIOA->CRL = 0x44444444;
	GPIOA->CRH = 0x44444444;
	GPIOA->CRL &= ~(0x0F);                             // GPIOA pin 0 analog input
}

void Adc_Config(void){
	RCC->APB2ENR |= (1<<9); 							//ADC CLOCK ENABLE
//	RCC->APB2ENR &= ~(1<<0);							//RESET AFIOEN CLOCK
	ADC1->CR1 &= ~(0x0F0000);							//ADC MODE SELECTİON
	ADC1->CR2 |= (1<<1);								//CONTİNUOUS MODE
	ADC1->CR2 &= ~(1<<11);								// LEFT ALLIGN
																										//!! CATİONNN ÖNEMLİ{
	ADC1->CR2 |= (1<<20);							//triger ENABLE
	ADC1->CR2 |= (0xE0000);							//triger swsstar selection
																										// !! CATİON ÖNEMLİ{

}

void Read_Adc(){

	HAL_Delay(500);

	ADC1->CR2 |= (1<<0);					//ADC ON

	ADC1->CR2 |= (0x400000);               //START CONVERSİON

	while(!(ADC1->SR & (1<<1)));        // wait end of conversion to get out

	adc_value = ADC1->DR;				// adc data register

	Vadc = 2.02 *  adc_value / 4095 ;

	ADC1->CR2 &= ~(1<<0);				//ADC OFF

}
/* USER CODE END 4 */

void Error_Handler(void)
{
  __disable_irq();
  while (1)
  {
  }
}

# file: 006_btn_led_blinking_register.ioc
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Mcu.Family=STM32F1
Mcu.Name=STM32F103C(8-B)Tx
Mcu.Package=LQFP48
NVIC.PriorityGroup=NVIC_PRIORITYGROUP_4
ProjectManager.HeapSize=0x200
ProjectManager.StackSize=0x400
ProjectManager.TargetToolchain=STM32CubeIDE
RCC.AHBFreq_Value=64000000
RCC.APB1CLKDivider=RCC_HCLK_DIV2
RCC.APB1Freq_Value=32000000
RCC.APB1TimFreq_Value=64000000
RCC.APB2Freq_Value=64000000
RCC.APB2TimFreq_Value=64000000
RCC.HCLKFreq_Value=64000000
RCC.PLLMUL=RCC_PLL_MUL16
RCC.SYSCLKFreq_VALUE=64000000
RCC.SYSCLKSource=RCC_SYSCLKSOURCE_PLLCLK
RCC.USBFreq_Value=64000000
board=custom

// file: Core/Src/main.c
/* USER CODE BEGIN Header */
/**
  ******************************************************************************
  * @file           : main.c
  * @brief          : Main program body
  ******************************************************************************
  * @attention
  *
  * Copyright (c) 2024 STMicroelectronics.
  * All rights reserved.
  *
  * This software is licensed under terms that can be found in the LICENSE file
  * in the root directory of this software component.
  * If no LICENSE file comes with this software, it is provided AS-IS.
  *
  ******************************************************************************
  */
/* USER CODE END Header */
#include "main.h"

/* USER CODE BEGIN PV */
void delay(uint32_t time){
	while(time--);
}

/* USER CODE END PV */

void SystemClock_Config(void);

int main(void)
{

  /* MCU Configuration--------------------------------------------------------*/

  /* Reset of all peripherals, Initializes the Flash interface and the Systick. */
  HAL_Init();

  /* Configure the system clock */
  SystemClock_Config();

  /* Initialize all configured peripherals */

  /* Infinite loop */
  while (1)
  {

    /* USER CODE BEGIN 3 */
	if(GPIOA->IDR & (1<<1)){
		while(GPIOA->IDR & (1<<1));
		GPIOB->ODR |= (1<<9);
		HAL_Delay(1000);
	}
	else{
		GPIOB->ODR &= ~(1<<9);
	}
  }

  /* USER CODE END 3 */
}

/* USER CODE BEGIN 4 */
void SystemClock_Config(void){

	RCC->CR |= 0x00000003;         		// HSI ON AND HSI FLAG SET
	while(!(RCC->CR & 0x00000003));    // wait for hsı ready
	RCC->CR |= 0x00080000; 			  // css(clock security sys.) on
	RCC->CFGR &= ~(1<<16);            // PLL ENTRY HSI SELECTED
	RCC->CFGR |= 0x00080000;         // pll multiplication x4
	RCC->CFGR |= (1<<2);             // PLL AS SYSTEM CLOCK

	RCC->CIR |= 0x00840000;             // flag reset ( css & hsı )
	RCC->APB2ENR |= 0x0000000C;         // GPIO A and B clock enable

	GPIOB->ODR |= 0x00000000;
	GPIOB->CRH |= 0x00000030;          //GPIOB port 9 mode: output and push-pull
	GPIOB->CRH &= ~(1<<6);
	GPIOB->CRH &= ~(1<<7);

	GPIOA->CRL &= ~(1<<0);             // GPIOA PORT 1 MODE: İNPUT and push-pull
	GPIOA->CRL &=  ~(1<<1);
	GPIOA->CRL |= 0x00000008;

}

/* USER CODE END 4 */

void Error_Handler(void)
{
  __disable_irq();
  while (1)
  {
  }
}

# file: 049_Flash_Memory_Register.ioc
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Mcu.Family=STM32F1
Mcu.Name=STM32F103C(8-B)Tx
Mcu.Package=LQFP48
NVIC.PriorityGroup=NVIC_PRIORITYGROUP_4
PA13.Mode=Serial_Wire
PA13.Signal=SYS_JTMS-SWDIO
PA14.Mode=Serial_Wire
PA14.Signal=SYS_JTCK-SWCLK
ProjectManager.HeapSize=0x200
ProjectManager.StackSize=0x400
ProjectManager.TargetToolchain=STM32CubeIDE
RCC.APB1Freq_Value=8000000
RCC.APB2Freq_Value=8000000
board=custom

// file: Core/Src/main.c
/* USER CODE BEGIN Header */
/**
  ******************************************************************************
  * @file           : main.c
  * @brief          : Main program body
  ******************************************************************************
  * @attention
  *
  * Copyright (c) 2024 STMicroelectronics.
  * All rights reserved.
  *
  * This software is licensed under terms that can be found in the LICENSE file
  * in the root directory of this software component.
  * If no LICENSE file comes with this software, it is provided AS-IS.
  *
  ******************************************************************************
  */
/* USER CODE END Header */
#include "main.h"

/* USER CODE BEGIN PV */
uint16_t data;

/* USER CODE END PV */

void SystemClock_Config(void);
static void MX_GPIO_Init(void);
/* USER CODE BEGIN PFP */
uint16_t Flash_Read(uint32_t address);
void RCC_Config(void);
void Flash_Unlock(void);
void Flash_Erase(void);
void Flash_Write(uint32_t address, uint16_t data);
void Flash_Locker(void);

/* USER CODE END PFP */

int main(void)
{

  /* MCU Configuration--------------------------------------------------------*/

  /* Reset of all peripherals, Initializes the Flash interface and the Systick. */
  HAL_Init();

  /* Configure the system clock */
  SystemClock_Config();

  /* Initialize all configured peripherals */
  MX_GPIO_Init();
  /* USER CODE BEGIN 2 */

  Flash_Unlock();
  Flash_Erase();
  Flash_Write(0x08002C00, 0xCC);
  Flash_Locker();
  Flash_Unlock();
  data = Flash_Read(0x08002C00);
  Flash_Locker();

  /* USER CODE END 2 */

  /* Infinite loop */
  while (1)
  {

  }
}

void SystemClock_Config(void)
{
  RCC_OscInitTypeDef RCC_OscInitStruct = {0};
  RCC_ClkInitTypeDef RCC_ClkInitStruct = {0};

  /** Initializes the RCC Oscillators according to the specified parameters
  * in the RCC_OscInitTypeDef structure.
  */
  RCC_OscInitStruct.OscillatorType = RCC_OSCILLATORTYPE_HSI;
  RCC_OscInitStruct.HSIState = RCC_HSI_ON;
  RCC_OscInitStruct.HSICalibrationValue = RCC_HSICALIBRATION_DEFAULT;
  RCC_OscInitStruct.PLL.PLLState = RCC_PLL_NONE;
  if (HAL_RCC_OscConfig(&RCC_OscInitStruct) != HAL_OK)
  {
    Error_Handler();
  }

  /** Initializes the CPU, AHB and APB buses clocks
  */
  RCC_ClkInitStruct.ClockType = RCC_CLOCKTYPE_HCLK|RCC_CLOCKTYPE_SYSCLK
                              |RCC_CLOCKTYPE_PCLK1|RCC_CLOCKTYPE_PCLK2;
  RCC_ClkInitStruct.SYSCLKSource = RCC_SYSCLKSOURCE_HSI;
  RCC_ClkInitStruct.AHBCLKDivider = RCC_SYSCLK_DIV1;
  RCC_ClkInitStruct.APB1CLKDivider = RCC_HCLK_DIV1;
  RCC_ClkInitStruct.APB2CLKDivider = RCC_HCLK_DIV1;

  if (HAL_RCC_ClockConfig(&RCC_ClkInitStruct, FLASH_LATENCY_0) != HAL_OK)
  {
    Error_Handler();
  }
}

static void MX_GPIO_Init(void)
{

  /* GPIO Ports Clock Enable */
  __HAL_RCC_GPIOA_CLK_ENABLE();

}

/* USER CODE BEGIN 4 */

void RCC_Config(void){

	RCC->CR |= 0x03;                                    // hsi and hsiready on
	while(!(RCC->CR & (1<<1)));                         //wait hsi ready
	RCC->CR |= (1 << 19);								// CSS ON
	RCC->CFGR &= ~(1 << 16);                            // HSI SOURCE HSI
	RCC->CFGR = 0x0140000;								// pll x7
	RCC->CFGR |= (1<<1);								//PLL AS SYSTEM CLOCK
	RCC->CFGR |= (1 << 14);                             // ADC PRESCALER /4
	RCC->CIR  &= ~(0x0840000);							//flag reset(css and hsi)

}

void Flash_Unlock(void){

	while((FLASH->SR & 0x00010000) != 0);

	FLASH->KEYR = 0x45670123;
	FLASH->KEYR = 0xCDEF89AB;
}

void Flash_Erase(void){
	while((FLASH->SR & 0x00010000) != 0);			// wait no memory operation

	FLASH->CR |= 1 << 1;							// erase select

	FLASH->AR |= (0x08002C00);						// page 11 selected

	FLASH->CR |= (1 << 6);							// start bit enable

	while((FLASH->SR & 0x00010000) != 0);			// wait no memory operation
}

void Flash_Write(uint32_t address, uint16_t data){

	while((FLASH->SR & 0x00010000) != 0);			// wait no memory operation

	FLASH->CR |= (1 << 0);							// programming chosen

	*(__IO  uint32_t*) address = data;				// assign data to the address

	while((FLASH->SR & 0x00010000) != 0);			// wait no memory operation,

}

uint16_t Flash_Read(uint32_t address){
	uint16_t  my_flashData;

	my_flashData = *(uint32_t*) address;

	while((FLASH->SR & 0x00010000) != 0);			// wait no memory operation

	return my_flashData;

}

void Flash_Locker(void){

	while((FLASH->SR & 0x00010000) != 0);			// wait no memory operation,

	FLASH->CR |= (1 << 7);							// LOCK bit set
}

/* USER CODE END 4 */

void Error_Handler(void)
{
  __disable_irq();
  while (1)
  {
  }
}

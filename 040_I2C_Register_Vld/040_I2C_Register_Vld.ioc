# file: 040_I2C_Register_Vld.ioc
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Mcu.Family=STM32F1
Mcu.Name=STM32F100R(8-B)Tx
Mcu.Package=LQFP64
NVIC.PriorityGroup=NVIC_PRIORITYGROUP_4
PA13.Mode=Serial_Wire
PA13.Signal=SYS_JTMS-SWDIO
PA14.Mode=Serial_Wire
PA14.Signal=SYS_JTCK-SWCLK
ProjectManager.HeapSize=0x200
ProjectManager.StackSize=0x400
ProjectManager.TargetToolchain=STM32CubeIDE
RCC.APB1Freq_Value=8000000
RCC.APB2Freq_Value=8000000
board=custom

// file: Core/Src/main.c
/* USER CODE BEGIN Header */
/**
  ******************************************************************************
  * @file           : main.c
  * @brief          : Main program body
  ******************************************************************************
  * @attention
  *
  * Copyright (c) 2024 STMicroelectronics.
  * All rights reserved.
  *
  * This software is licensed under terms that can be found in the LICENSE file
  * in the root directory of this software component.
  * If no LICENSE file comes with this software, it is provided AS-IS.
  *
  ******************************************************************************
  */
/* USER CODE END Header */
#include "main.h"

/* USER CODE BEGIN PV */
int i = 0;
uint8_t m_address = 0x4E;

/* USER CODE END PV */

void SystemClock_Config(void);
static void MX_GPIO_Init(void);
/* USER CODE BEGIN PFP */
void RCC_Config(void);
void GPIO_Config(void);
void I2C_Config(void);
uint8_t I2C_Write(uint8_t , uint8_t );

/* USER CODE END PFP */

/* USER CODE BEGIN 0 */
void RCC_Config(void){

	RCC->CFGR |= (0x0110002);							// PLL X6 & SW SOURCE = PLL & PLL ENTRY = PREDIV1
	RCC->CFGR2 |= (0x01);								// PREDIV /2
	RCC->CR |= 0x1090000; 								// HSE & PLL & CSS ON
	wait(RCC->CR & (0x2020000) == HAL_OK);				// WAIT HSE & PLL READY

	RCC->CIR |= (0x0980000); 							// HSE PLL CSS FLAG RESET

}
void GPIO_Config(void){

	RCC->APB2ENR |= (0x0D << 0);  						// AF GPIOA GPIOB CLK ENABLE

	GPIOB->CRH |= (0xDD < 0); 							// B10 & B11 AF_OD - 10MHZ

	GPIOB->CRL |= (8 << 0);								// B1 PUSH BUTTON IN_PP_PD

}

void I2C_Config(void){

	RCC->APB1ENR |= (1 << 22);						// I2C2 CLK ENABLE

	I2C2->CR2 |= (8 << 0);							// FREQ = 8 MHZ
	I2C2->CCR |= (0x028);							// 100 KHZ
	I2C2->TRISE |= (0x9);							//
	I2C2->CR1 |= (1 << 0);							// PERIPH ENABLE
}

uint8_t I2C_Write(uint8_t addres, uint8_t data){

	I2C2->CR1 |= (1 << 8 );						// SEND START BIT
	while(!(I2C2->CR1 & (1 << 0)));				// WAIT START BIT SENT
	I2C2->DR |= 0x4E;							// SLAVE ADDRES
	while(!(I2C2->SR1 & (0x002)));				// WAIT SEND ADDRES
	while(!(I2C2->SR2 & (0x001)));				// WAIT MSL ( MASTER SLAVE MODE)
//	I2C2->DR |= addres;
	while(!(I2C2->SR1 & (0x0070)));				// WAIT DATA REGISTER EMPTY ( TxE )
	while(!(I2C2->SR1 & (1 << 2))); 			// WAIT BYTE TRANSFER FINISHED ( BTF )
	I2C2->CR1 |= (1 << 9); 						// SEND STOP BIT
}

void delay(uint8_t time){
	while(time--);
}

/* USER CODE END 0 */

int main(void)
{

  /* MCU Configuration--------------------------------------------------------*/

  /* Reset of all peripherals, Initializes the Flash interface and the Systick. */
  HAL_Init();

  /* Configure the system clock */
  SystemClock_Config();

  /* Initialize all configured peripherals */
  MX_GPIO_Init();
  /* USER CODE BEGIN 2 */
  void RCC_Config(void);
  void GPIO_Config(void);
  void I2C_Config(void);

  /* USER CODE END 2 */

  /* Infinite loop */
  while (1)
  {

    /* USER CODE BEGIN 3 */
	  if(GPIOB->IDR == GPIO_PIN_SET){
		  while(GPIOB->IDR & GPIO_PIN_SET);
		  i++;
		  delay(2100000);
	  }

	  switch (i){

	  case 0:
		  I2C_Write(m_address, 0x00);
		  break;
	  case 1:
		  I2C_Write(m_address, 0x01);
		  break;
	  case 2:
		  I2C_Write(m_address, 0x02);
		  break;
	  case 3:
		  I2C_Write(m_address, 0x04);
		  break;
	  case 4:
		  I2C_Write(m_address, 0x08);
		  break;
	  case 5:
		  I2C_Write(m_address, 0x10);
		  break;
	  case 6:
		  I2C_Write(m_address, 0x20);
		  break;
	  case 7:
		  I2C_Write(m_address, 0x40);
		  break;
	  case 8:
		  I2C_Write(m_address, 0x80);
		  break;

	  default:
		  i = 0;
		  break;
	  }

  }
  /* USER CODE END 3 */
}

void SystemClock_Config(void)
{
  RCC_OscInitTypeDef RCC_OscInitStruct = {0};
  RCC_ClkInitTypeDef RCC_ClkInitStruct = {0};

  /** Initializes the RCC Oscillators according to the specified parameters
  * in the RCC_OscInitTypeDef structure.
  */
  RCC_OscInitStruct.OscillatorType = RCC_OSCILLATORTYPE_HSI;
  RCC_OscInitStruct.HSIState = RCC_HSI_ON;
  RCC_OscInitStruct.HSICalibrationValue = RCC_HSICALIBRATION_DEFAULT;
  RCC_OscInitStruct.PLL.PLLState = RCC_PLL_NONE;
  if (HAL_RCC_OscConfig(&RCC_OscInitStruct) != HAL_OK)
  {
    Error_Handler();
  }

  /** Initializes the CPU, AHB and APB buses clocks
  */
  RCC_ClkInitStruct.ClockType = RCC_CLOCKTYPE_HCLK|RCC_CLOCKTYPE_SYSCLK
                              |RCC_CLOCKTYPE_PCLK1|RCC_CLOCKTYPE_PCLK2;
  RCC_ClkInitStruct.SYSCLKSource = RCC_SYSCLKSOURCE_HSI;
  RCC_ClkInitStruct.AHBCLKDivider = RCC_SYSCLK_DIV1;
  RCC_ClkInitStruct.APB1CLKDivider = RCC_HCLK_DIV1;
  RCC_ClkInitStruct.APB2CLKDivider = RCC_HCLK_DIV1;

  if (HAL_RCC_ClockConfig(&RCC_ClkInitStruct, FLASH_LATENCY_0) != HAL_OK)
  {
    Error_Handler();
  }
}

static void MX_GPIO_Init(void)
{

  /* GPIO Ports Clock Enable */
  __HAL_RCC_GPIOA_CLK_ENABLE();

}

void Error_Handler(void)
{
  __disable_irq();
  while (1)
  {
  }
}

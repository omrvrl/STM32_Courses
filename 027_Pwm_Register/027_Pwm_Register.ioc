# file: 027_Pwm_Register.ioc
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Mcu.Family=STM32F1
Mcu.Name=STM32F103C(8-B)Tx
Mcu.Package=LQFP48
NVIC.PriorityGroup=NVIC_PRIORITYGROUP_4
PA13.Mode=Serial_Wire
PA13.Signal=SYS_JTMS-SWDIO
PA14.Mode=Serial_Wire
PA14.Signal=SYS_JTCK-SWCLK
ProjectManager.HeapSize=0x200
ProjectManager.StackSize=0x400
ProjectManager.TargetToolchain=STM32CubeIDE
RCC.APB1Freq_Value=8000000
RCC.APB2Freq_Value=8000000
board=custom

// file: Core/Src/main.c
/* USER CODE BEGIN Header */
/**
  ******************************************************************************
  * @file           : main.c
  * @brief          : Main program body
  ******************************************************************************
  * @attention
  *
  * Copyright (c) 2024 STMicroelectronics.
  * All rights reserved.
  *
  * This software is licensed under terms that can be found in the LICENSE file
  * in the root directory of this software component.
  * If no LICENSE file comes with this software, it is provided AS-IS.
  *
  ******************************************************************************
  */
/* USER CODE END Header */
#include "main.h"

void SystemClock_Config(void);
static void MX_GPIO_Init(void);
void TIM_Config(void);

int main(void)
{

  /* MCU Configuration--------------------------------------------------------*/

  /* Reset of all peripherals, Initializes the Flash interface and the Systick. */
  HAL_Init();

  /* Configure the system clock */
  SystemClock_Config();

  /* Initialize all configured peripherals */
  MX_GPIO_Init();
  /* USER CODE BEGIN 2 */
  TIM_Config();
  MX_GPIO_Init();

  /* USER CODE END 2 */

  /* Infinite loop */
  while (1)
  {

  }
}
/**
 * @brief timer config,
 * @retval None
 * @param None
 */

void TIM_Config(void){

	RCC->APB1ENR |= 1 <<2 ;            // TIM4 Enable

	TIM4->CR1 &= ~(0 << 4); 			// counter: upcount
	TIM4->CR1 &= ~(0x060);				// edge-alligned mode
	TIM4->CR1 &= ~(0x0300);				// clock division x1

	TIM4->EGR |= (1 << 1);				// Reinitialize counter
	TIM4->SMCR &= ~(0x07);        		// DİSABLE SLAVE MODE
//	TIM4->PSC = 15999;                  // PRESCALER tick_ck =  apb1_CK / PSC +1
//	TIM4->ARR = 4000;					// auto-reload value: count up to 4000
	TIM4->CR1 |= (1<<0);                // COUNTER Enable

/**	TIM4->CCMR1 &= 0 << 0 | 0 << 1;     // COMPARE 1 CONFİGURED AS OUTPUT
 * 	IM4->CCMR1 |= 1 << 5 | 1 << 6;      // COMPARE 1 MODE PWM
 *  TIM4->CCMR1 &= 0 << 8 | 0 << 9;     // COMPARE 2 CONFİGUREC AS OUTPUT
 *	TIM4->CCMR1 |= 6 << 12;             // COMPARE 2 MODE PWM
 */
	TIM4->CCMR1 |= 0 << 0 | 6 << 4 | 0 << 8 | 6 << 12;     // CH 1 & 2 CONFİGURATİON: OUTPUT AND PWN MODE 1

	TIM4->CCER |= 1 << 0 | 1 << 4;      // CH 1 & 2 ENABLE

	TIM4->PSC = 6399;
	TIM4->ARR = 9999;
	TIM4->CCR1 = 2499;				// ! PWM PULSE DEĞERİ YANİ AMPLİTUDE DEĞERİ
	TIM4->CCR2 = 7099;
	TIM4->CR1 |= 1 << 0;			// timer 4 enable

}
void SystemClock_Config(void)
{
	RCC->CR |= 0x03;                                     // hsi and hsiready on
	while(!(RCC->CR & (1<<1)));                         //wait hsi ready
	RCC->CR |= (1 << 19);								 // CSS ON
	RCC->CFGR &= ~(1 << 16);                             // HSI SOURCE HSI
	RCC->CFGR = 0x0140000;								// pll x7
	RCC->CFGR |= (1<<1);								//PLL AS SYSTEM CLOCK
	RCC->CFGR |= (1 << 14);                             // ADC PRESCALER /4
	RCC->CIR  &= ~(0x0840000);								//flag reset(css and hsi)
}

static void MX_GPIO_Init(void)
{

  /* GPIO Ports Clock Enable */
	RCC->APB2ENR |= 1 << 3 ;          					// GPIOB ENABLE

	GPIOB->CRL |= 1 << 24 | 1 << 25 | 1 << 27;			//GPIOB PORT 6 CONFİG: AF - 50 MHz
	GPIOB->CRL &= ~(1 << 26);
	GPIOB->CRL |= 0xB0000000;			  				// GPIOB PORT 7 MODE SELECTION: AF - 50 MHz
	GPIOB->CRL &= ~(1 << 30);
	AFIO->MAPR &= 0 << 12 ;           					// AF mode selection: TIM2 (PB6 PB7 PB8 PB9)

}

void Error_Handler(void)
{
  __disable_irq();
  while (1)
  {
  }
}

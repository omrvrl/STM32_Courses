# file: 002_Exti_btnled_register.ioc
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Mcu.Family=STM32F1
Mcu.Name=STM32F103C(8-B)Tx
Mcu.Package=LQFP48
NVIC.PriorityGroup=NVIC_PRIORITYGROUP_4
PA13.Mode=Serial_Wire
PA13.Signal=SYS_JTMS-SWDIO
PA14.Mode=Serial_Wire
PA14.Signal=SYS_JTCK-SWCLK
ProjectManager.HeapSize=0x200
ProjectManager.StackSize=0x400
ProjectManager.TargetToolchain=STM32CubeIDE
RCC.AHBFreq_Value=64000000
RCC.APB1CLKDivider=RCC_HCLK_DIV2
RCC.APB1Freq_Value=32000000
RCC.APB1TimFreq_Value=64000000
RCC.APB2Freq_Value=64000000
RCC.APB2TimFreq_Value=64000000
RCC.HCLKFreq_Value=64000000
RCC.PLLMUL=RCC_PLL_MUL16
RCC.SYSCLKFreq_VALUE=64000000
RCC.SYSCLKSource=RCC_SYSCLKSOURCE_PLLCLK
RCC.USBFreq_Value=64000000
board=custom

// file: Core/Src/main.c
/* USER CODE BEGIN Header */
/**
  ******************************************************************************
  * @file           : main.c
  * @brief          : Main program body
  ******************************************************************************
  * @attention
  *
  * Copyright (c) 2024 STMicroelectronics.
  * All rights reserved.
  *
  * This software is licensed under terms that can be found in the LICENSE file
  * in the root directory of this software component.
  * If no LICENSE file comes with this software, it is provided AS-IS.
  *
  ******************************************************************************
  */
/* USER CODE END Header */
#include "main.h"

/* USER CODE BEGIN PD */
int count = 0;

/* USER CODE END PD */

void SystemClock_Config(void);
static void MX_GPIO_Init(void);
/* USER CODE BEGIN PFP */
void EXTI_Init(void);

/* USER CODE END PFP */

/* USER CODE BEGIN 0 */
void EXTI0_IRQHandler(){
	count++;
	if(EXTI->PR & (1<<0)){
		GPIOB->ODR |= (1<<9);
		GPIOA->ODR |= (1<<8);
		HAL_Delay(5000);
	}

	GPIOB->ODR |= (1<<9);                                 //led high
	HAL_Delay(100);										  //delay
	GPIOB->ODR &= ~(1<<9);								  //led low
	HAL_Delay(100);										  //delay
	GPIOB->ODR |= (1<<9);								  //led high
	HAL_Delay(100);										  //delay
	GPIOB->ODR &=  ~(1<<9);								  //led low

}

/* USER CODE END 0 */

int main(void)
{

  /* MCU Configuration--------------------------------------------------------*/

  /* Reset of all peripherals, Initializes the Flash interface and the Systick. */
  HAL_Init();

  /* Configure the system clock */
  SystemClock_Config();

  /* Initialize all configured peripherals */
  MX_GPIO_Init();
  /* USER CODE BEGIN 2 */
  EXTI_Init();

  /* USER CODE END 2 */

  /* Infinite loop */
  while (1)
  {

  }
}

void SystemClock_Config(void)
{
  RCC_OscInitTypeDef RCC_OscInitStruct = {0};
  RCC_ClkInitTypeDef RCC_ClkInitStruct = {0};

  /** Initializes the RCC Oscillators according to the specified parameters
  * in the RCC_OscInitTypeDef structure.
  */
  RCC_OscInitStruct.OscillatorType = RCC_OSCILLATORTYPE_HSI;
  RCC_OscInitStruct.HSIState = RCC_HSI_ON;
  RCC_OscInitStruct.HSICalibrationValue = RCC_HSICALIBRATION_DEFAULT;
  RCC_OscInitStruct.PLL.PLLState = RCC_PLL_ON;
  RCC_OscInitStruct.PLL.PLLSource = RCC_PLLSOURCE_HSI_DIV2;
  RCC_OscInitStruct.PLL.PLLMUL = RCC_PLL_MUL16;
  if (HAL_RCC_OscConfig(&RCC_OscInitStruct) != HAL_OK)
  {
    Error_Handler();
  }

  /** Initializes the CPU, AHB and APB buses clocks
  */
  RCC_ClkInitStruct.ClockType = RCC_CLOCKTYPE_HCLK|RCC_CLOCKTYPE_SYSCLK
                              |RCC_CLOCKTYPE_PCLK1|RCC_CLOCKTYPE_PCLK2;
  RCC_ClkInitStruct.SYSCLKSource = RCC_SYSCLKSOURCE_PLLCLK;
  RCC_ClkInitStruct.AHBCLKDivider = RCC_SYSCLK_DIV1;
  RCC_ClkInitStruct.APB1CLKDivider = RCC_HCLK_DIV2;
  RCC_ClkInitStruct.APB2CLKDivider = RCC_HCLK_DIV1;

  if (HAL_RCC_ClockConfig(&RCC_ClkInitStruct, FLASH_LATENCY_2) != HAL_OK)
  {
    Error_Handler();
  }
}

static void MX_GPIO_Init(void)
{
/* USER CODE BEGIN MX_GPIO_Init_1 */
	RCC->APB2ENR |= 0x0C;         // GPIO A and B clock enable

	GPIOB->ODR |= 0x00000000;

	GPIOB->CRH |= (1<<0);		//GPIOB port 8  OUTPUT PUSH down
	GPIOB->CRH &= ~(1<<1);
	GPIOB->CRH &= ~(1<<2);
	GPIOB->CRH &= ~(1<<3);

	GPIOB->CRH |= (1<<4);     // GPIOB PORT 9 OUTPUT PUSH PULL
	GPIOB->CRH &= ~(1<<5);
	GPIOB->CRH &= ~(1<<6);
	GPIOB->CRH &= ~(1<<7);

//	GPIOA->CRL &= ~(1<<0);             // GPIOA PORT 0-1 MODE: İNPUT and push-pull
//	GPIOA->CRL &=  ~(1<<1);
	GPIOA->CRL &= ~(0x07);
	GPIOA->CRL |= 0x088;

/* USER CODE END MX_GPIO_Init_1 */

  /* GPIO Ports Clock Enable */

}

/* USER CODE BEGIN 4 */
void EXTI_Init(){
	// EXTI CONFİG SETTİNGS FOR EXTERNAL İNTERRUPT İNPUTS : A0 A1
	EXTI->IMR |= 0x01;				//A0 İNPUT UNMASKİNG
	EXTI->RTSR |= 0x01;				//RİSİNG TRİGGER  ACTİVE
	EXTI->FTSR &= 0x00;				//FALL TRİGGER  RESET STATE

	NVIC_SetPriority(EXTI0_IRQn,0); //SETTING PRIORITY
	NVIC_EnableIRQ(EXTI0_IRQn);		//ENABLE NVIC IRQ LINE

}

/* USER CODE END 4 */

void Error_Handler(void)
{
  __disable_irq();
  while (1)
  {
  }
}
